## src/linux_harness/sw/br2_external/Config.in
```kconfig
source "$BR2_EXTERNAL_MPS3_HARNESS_PATH/package/mps3-harnessd/Config.in"
source "$BR2_EXTERNAL_MPS3_HARNESS_PATH/package/mps3-spi-usd/Config.in"
source "$BR2_EXTERNAL_MPS3_HARNESS_PATH/package/mps3-slot/Config.in"
source "$BR2_EXTERNAL_MPS3_HARNESS_PATH/package/mps3-debug/Config.in"
comment "legacy variant (v0.7 daemons, mps3_dfx.ko, mps3-clcdd) - until the deletion PR"
source "$BR2_EXTERNAL_MPS3_HARNESS_PATH/package/mps3-legacy-daemons/Config.in"
source "$BR2_EXTERNAL_MPS3_HARNESS_PATH/package/mps3-apps/Config.in"
source "$BR2_EXTERNAL_MPS3_HARNESS_PATH/package/mps3-dfx/Config.in"
```

## src/linux_harness/sw/br2_external/package/mps3-debug/Config.in
```kconfig
config BR2_PACKAGE_MPS3_DEBUG
	bool "mps3-debug (the on-board GDB server)"
	select BR2_PACKAGE_OPENOCD
	help
	  /usr/bin/mps3-debug up|down|status|version: OpenOCD ON the board,
	  as the unprivileged openocd user, remote_bitbang to the harness's
	  own 127.0.0.1:6921, GDB/telnet/Tcl bound to 127.0.0.1 (reached over
	  the claim's SSH). Brings Buildroot's openocd with remote_bitbang
	  and the SoC Labs ahb_qspi + hostio4 drivers (sw/patches/openocd),
	  the target configs (host/openocd) and the design table.
```

## src/linux_harness/sw/br2_external/package/mps3-dfx/Config.in
```kconfig
config BR2_PACKAGE_MPS3_DFX
	bool "mps3-dfx"
	depends on BR2_LINUX_KERNEL
	help
	  Out-of-tree MPS3 shell DFX swap driver (mps3_dfx.ko), the
	  /dev/mps3dfx chardev + fpga-mgr/fpga-bridge veneer the swap
	  service (mps3-ctrld's swap worker) drives through the frozen
	  ioctl sequence (SWAP_BEGIN -> clearing/partial push ->
	  SWAP_FINISH). Sources in ../../drivers/icap/.

	  LEGACY image variant only (DL6: harnessd drives ICAP through UIO
	  in the default image). Installs /etc/init.d/S10mps3dfx +
	  /etc/mps3/dfx.conf itself.

	  Loaded at boot by /etc/init.d/S10mps3dfx; the mock-vs-MMIO
	  backend is a deploy-time tech seam (/etc/mps3/dfx.conf).

comment "mps3-dfx needs a Linux kernel to be built"
	depends on !BR2_LINUX_KERNEL
```

## src/linux_harness/sw/br2_external/package/mps3-harnessd/Config.in
```kconfig
config BR2_PACKAGE_MPS3_HARNESSD
	bool "mps3-harnessd"
	help
	  The MPS3 shell's firmware service modules (coordinator, swap FSM,
	  config agent, JTAG/XVC/UART servers, CLCD/KVM/touch, clkrst,
	  identify) compiled UNMODIFIED for Linux as one process, against
	  the UIO register HAL, kernel sockets and a poll()-driven service
	  table (src/linux_harness/sw/harnessd/,
	  docs/planning/linux_lanes/HARNESSD_CONTRACT.md). Speaks the
	  bare-metal wire (net-protocol v0.11) plus the additive
	  version.impl = "linux".

	  Installs /usr/sbin/mps3-harnessd and the inittab drop-in
	  /usr/share/mps3/inittab.d/50-mps3-harnessd.inittab
	  (::respawn:/usr/sbin/mps3-harnessd), which IMAGE's provisioning
	  merges into /etc/inittab (IMAGE_CONTRACT.md §7.1).

	  Replaces the v0.7 hand-ported daemons, which stay buildable as
	  BR2_PACKAGE_MPS3_LEGACY_DAEMONS (the two are mutually exclusive:
	  they bind the same ports).
```

## src/linux_harness/sw/br2_external/package/mps3-legacy-daemons/Config.in
```kconfig
config BR2_PACKAGE_MPS3_LEGACY_DAEMONS
	bool "mps3-legacy-daemons (v0.7 hand port)"
	depends on !BR2_PACKAGE_MPS3_HARNESSD
	help
	  The July 2026 hand-ported control-plane daemons (net-protocol
	  v0.7): mps3-ctrld (6900), mps3-pushd (6910), mps3-configd (TFTP
	  69), mps3-xvcd (2542), mps3-uartbrd (6930-6932), started by
	  S90mps3d + S91mps3aux. Superseded by mps3-harnessd (DL6); kept
	  buildable as the LEGACY image variant (build.sh
	  MPS3_VARIANT=legacy) until the deletion PR. Mutually exclusive
	  with mps3-harnessd: both bind the same ports.
```

## src/linux_harness/sw/br2_external/package/mps3-slot/Config.in
```kconfig
config BR2_PACKAGE_MPS3_SLOT
	bool "mps3-slot"
	help
	  /usr/sbin/mps3-slot: the Linux side of stage0's user-microSD
	  layout (STAGE0_CONTRACT §6) — status, the power-safe boot-select
	  sector write (lower-seq copy, max+1), and writing a checked S0LB
	  image into slot A or B.
```

## src/linux_harness/sw/br2_external/package/mps3-spi-usd/Config.in
```kconfig
config BR2_PACKAGE_MPS3_SPI_USD
	bool "mps3-spi-usd"
	depends on BR2_LINUX_KERNEL
	help
	  spi-usd.ko: the SPI controller driver for the MPS3 shell's usd_spi
	  block (D13, the USER microSD at 0x44A4_0000). The stock mmc_spi
	  slot sits on it (/dev/mmcblk0); its one-line GPIO chip is the
	  slot's card detect. Loaded at boot by S11modules
	  (/etc/modules-load.d/mps3-spi-usd.conf). Inert without a
	  "soclabs,usd-spi-1.0" node; refuses (-ENODEV) a shell whose
	  0x44A4 page does not read ID 0x55534431.

comment "mps3-spi-usd needs a Linux kernel to be built"
	depends on !BR2_LINUX_KERNEL
```
